SECTIONS
{
	.my_absMemAccessSegment 0x72020000 : {KEEP(*(.my_absMemAccessSection))}
	.my_absNoReadAllocaSegment 0x71020108 : {KEEP(*(.my_absNoReadAllocaSection))}
	.my_absReadAllocaSegment 0x74020108 : {KEEP(*(.my_absReadAllocaSection))}
	.my_absNoWriteDeallocaSegment 0x73020108 : {KEEP(*(.my_absNoWriteDeallocaSection))}
	.my_absWriteDeallocaSegment 0x75020100 : {KEEP(*(.my_absWriteDeallocaSection))}
	.my_fabsMemAccessSegment 0x72010000 : {KEEP(*(.my_fabsMemAccessSection))}
	.my_fabsNoReadAllocaSegment 0x71010208 : {KEEP(*(.my_fabsNoReadAllocaSection))}
	.my_fabsReadAllocaSegment 0x74010208 : {KEEP(*(.my_fabsReadAllocaSection))}
	.my_fabsNoWriteDeallocaSegment 0x73010208 : {KEEP(*(.my_fabsNoWriteDeallocaSection))}
	.my_fabsWriteDeallocaSegment 0x75010200 : {KEEP(*(.my_fabsWriteDeallocaSection))}
	.my_sinMemAccessSegment 0x72020000 : {KEEP(*(.my_sinMemAccessSection))}
	.my_sinNoReadAllocaSegment 0x71020310 : {KEEP(*(.my_sinNoReadAllocaSection))}
	.my_sinReadAllocaSegment 0x74020310 : {KEEP(*(.my_sinReadAllocaSection))}
	.my_sinNoWriteDeallocaSegment 0x73020310 : {KEEP(*(.my_sinNoWriteDeallocaSection))}
	.my_sinWriteDeallocaSegment 0x75020300 : {KEEP(*(.my_sinWriteDeallocaSection))}
	.my_cosMemAccessSegment 0x72010000 : {KEEP(*(.my_cosMemAccessSection))}
	.my_cosNoReadAllocaSegment 0x71010404 : {KEEP(*(.my_cosNoReadAllocaSection))}
	.my_cosReadAllocaSegment 0x74010404 : {KEEP(*(.my_cosReadAllocaSection))}
	.my_cosNoWriteDeallocaSegment 0x73010404 : {KEEP(*(.my_cosNoWriteDeallocaSection))}
	.my_cosWriteDeallocaSegment 0x75010400 : {KEEP(*(.my_cosWriteDeallocaSection))}
	.encodeMemAccessSegment 0x72010000 : {KEEP(*(.encodeMemAccessSection))}
	.encodeNoReadAllocaSegment 0x71010518 : {KEEP(*(.encodeNoReadAllocaSection))}
	.encodeReadAllocaSegment 0x74010518 : {KEEP(*(.encodeReadAllocaSection))}
	.encodeNoWriteDeallocaSegment 0x73010518 : {KEEP(*(.encodeNoWriteDeallocaSection))}
	.encodeWriteDeallocaSegment 0x75010500 : {KEEP(*(.encodeWriteDeallocaSection))}
	.filtezMemAccessSegment 0x72020000 : {KEEP(*(.filtezMemAccessSection))}
	.filtezNoReadAllocaSegment 0x71020608 : {KEEP(*(.filtezNoReadAllocaSection))}
	.filtezReadAllocaSegment 0x74020608 : {KEEP(*(.filtezReadAllocaSection))}
	.filtezNoWriteDeallocaSegment 0x73020608 : {KEEP(*(.filtezNoWriteDeallocaSection))}
	.filtezWriteDeallocaSegment 0x75020600 : {KEEP(*(.filtezWriteDeallocaSection))}
	.filtepMemAccessSegment 0x72020000 : {KEEP(*(.filtepMemAccessSection))}
	.filtepNoReadAllocaSegment 0x71020718 : {KEEP(*(.filtepNoReadAllocaSection))}
	.filtepReadAllocaSegment 0x74020718 : {KEEP(*(.filtepReadAllocaSection))}
	.filtepNoWriteDeallocaSegment 0x73020718 : {KEEP(*(.filtepNoWriteDeallocaSection))}
	.filtepWriteDeallocaSegment 0x75020700 : {KEEP(*(.filtepWriteDeallocaSection))}
	.quantlMemAccessSegment 0x72030000 : {KEEP(*(.quantlMemAccessSection))}
	.quantlNoReadAllocaSegment 0x71030818 : {KEEP(*(.quantlNoReadAllocaSection))}
	.quantlReadAllocaSegment 0x74030818 : {KEEP(*(.quantlReadAllocaSection))}
	.quantlNoWriteDeallocaSegment 0x73030818 : {KEEP(*(.quantlNoWriteDeallocaSection))}
	.quantlWriteDeallocaSegment 0x75030800 : {KEEP(*(.quantlWriteDeallocaSection))}
	.logsclMemAccessSegment 0x72020000 : {KEEP(*(.logsclMemAccessSection))}
	.logsclNoReadAllocaSegment 0x7102090c : {KEEP(*(.logsclNoReadAllocaSection))}
	.logsclReadAllocaSegment 0x7402090c : {KEEP(*(.logsclReadAllocaSection))}
	.logsclNoWriteDeallocaSegment 0x7302090c : {KEEP(*(.logsclNoWriteDeallocaSection))}
	.logsclWriteDeallocaSegment 0x75020900 : {KEEP(*(.logsclWriteDeallocaSection))}
	.scalelMemAccessSegment 0x72020000 : {KEEP(*(.scalelMemAccessSection))}
	.scalelNoReadAllocaSegment 0x71020a14 : {KEEP(*(.scalelNoReadAllocaSection))}
	.scalelReadAllocaSegment 0x74020a14 : {KEEP(*(.scalelReadAllocaSection))}
	.scalelNoWriteDeallocaSegment 0x73020a14 : {KEEP(*(.scalelNoWriteDeallocaSection))}
	.scalelWriteDeallocaSegment 0x75020a00 : {KEEP(*(.scalelWriteDeallocaSection))}
	.upzeroMemAccessSegment 0x72020000 : {KEEP(*(.upzeroMemAccessSection))}
	.upzeroNoReadAllocaSegment 0x71020b10 : {KEEP(*(.upzeroNoReadAllocaSection))}
	.upzeroReadAllocaSegment 0x74020b10 : {KEEP(*(.upzeroReadAllocaSection))}
	.upzeroNoWriteDeallocaSegment 0x73020b10 : {KEEP(*(.upzeroNoWriteDeallocaSection))}
	.upzeroWriteDeallocaSegment 0x75020b00 : {KEEP(*(.upzeroWriteDeallocaSection))}
	.uppol2MemAccessSegment 0x72020000 : {KEEP(*(.uppol2MemAccessSection))}
	.uppol2NoReadAllocaSegment 0x71020c20 : {KEEP(*(.uppol2NoReadAllocaSection))}
	.uppol2ReadAllocaSegment 0x74020c20 : {KEEP(*(.uppol2ReadAllocaSection))}
	.uppol2NoWriteDeallocaSegment 0x73020c20 : {KEEP(*(.uppol2NoWriteDeallocaSection))}
	.uppol2WriteDeallocaSegment 0x75020c00 : {KEEP(*(.uppol2WriteDeallocaSection))}
	.uppol1MemAccessSegment 0x72020000 : {KEEP(*(.uppol1MemAccessSection))}
	.uppol1NoReadAllocaSegment 0x71020d1c : {KEEP(*(.uppol1NoReadAllocaSection))}
	.uppol1ReadAllocaSegment 0x74020d1c : {KEEP(*(.uppol1ReadAllocaSection))}
	.uppol1NoWriteDeallocaSegment 0x73020d1c : {KEEP(*(.uppol1NoWriteDeallocaSection))}
	.uppol1WriteDeallocaSegment 0x75020d00 : {KEEP(*(.uppol1WriteDeallocaSection))}
	.logschMemAccessSegment 0x72020000 : {KEEP(*(.logschMemAccessSection))}
	.logschNoReadAllocaSegment 0x71020e0c : {KEEP(*(.logschNoReadAllocaSection))}
	.logschReadAllocaSegment 0x74020e0c : {KEEP(*(.logschReadAllocaSection))}
	.logschNoWriteDeallocaSegment 0x73020e0c : {KEEP(*(.logschNoWriteDeallocaSection))}
	.logschWriteDeallocaSegment 0x75020e00 : {KEEP(*(.logschWriteDeallocaSection))}
	.decodeMemAccessSegment 0x72010000 : {KEEP(*(.decodeMemAccessSection))}
	.decodeNoReadAllocaSegment 0x71010f10 : {KEEP(*(.decodeNoReadAllocaSection))}
	.decodeReadAllocaSegment 0x74010f10 : {KEEP(*(.decodeReadAllocaSection))}
	.decodeNoWriteDeallocaSegment 0x73010f10 : {KEEP(*(.decodeNoWriteDeallocaSection))}
	.decodeWriteDeallocaSegment 0x75010f00 : {KEEP(*(.decodeWriteDeallocaSection))}
	.resetMemAccessSegment 0x72010000 : {KEEP(*(.resetMemAccessSection))}
	.resetNoReadAllocaSegment 0x71011004 : {KEEP(*(.resetNoReadAllocaSection))}
	.resetReadAllocaSegment 0x74011004 : {KEEP(*(.resetReadAllocaSection))}
	.resetNoWriteDeallocaSegment 0x73011004 : {KEEP(*(.resetNoWriteDeallocaSection))}
	.resetWriteDeallocaSegment 0x75011000 : {KEEP(*(.resetWriteDeallocaSection))}
	.mainMemAccessSegment 0x72020000 : {KEEP(*(.mainMemAccessSection))}
	.mainNoReadAllocaSegment 0x71021110 : {KEEP(*(.mainNoReadAllocaSection))}
	.mainReadAllocaSegment 0x74021110 : {KEEP(*(.mainReadAllocaSection))}
	.mainNoWriteDeallocaSegment 0x73021110 : {KEEP(*(.mainNoWriteDeallocaSection))}
	.mainWriteDeallocaSegment 0x75021100 : {KEEP(*(.mainWriteDeallocaSection))}
	.MMemAccessSegment 0x72000000 : {KEEP(*(.MMemAccessSection))}
	.MNoReadAllocaSegment 0x71006433c : {KEEP(*(.MNoReadAllocaSection))}
	.MNoWriteDeallocaSegment 0x73006433c : {KEEP(*(.MNoWriteDeallocaSection))}

}
